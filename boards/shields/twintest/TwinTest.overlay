#include <dt-bindings/zmk/matrix_transform.h>

/ {
    chosen {
        zmk,kscan = &default_kscan;
    };
    

    default_kscan: kscan {
        compatible = "zmk,kscan-gpio-matrix";
        label = "default_kscan";
        diode-direction = "col2row";

        row-gpios = <&gpio0 31 (GPIO_ACTIVE_HIGH | GPIO_PULL_DOWN)>,
                    <&gpio0 29 (GPIO_ACTIVE_HIGH | GPIO_PULL_DOWN)>,
                    <&gpio0 2 (GPIO_ACTIVE_HIGH | GPIO_PULL_DOWN)>,
                    <&gpio1 15 (GPIO_ACTIVE_HIGH | GPIO_PULL_DOWN)>,
                    <&gpio1 13 (GPIO_ACTIVE_HIGH | GPIO_PULL_DOWN)>;
        
        col-gpios = <&gpio0 17 GPIO_ACTIVE_HIGH>,
                    <&gpio0 20 GPIO_ACTIVE_HIGH>,
                    <&gpio0 22 GPIO_ACTIVE_HIGH>,
                    <&gpio0 24 GPIO_ACTIVE_HIGH>,
                    <&gpio1 0 GPIO_ACTIVE_HIGH>,
                    <&gpio0 11 GPIO_ACTIVE_HIGH>;

    };
};