#include "Dolle.dtsi"

    // chosen {
    //     zmk,kscan = &default_kscan;
    //     zmk,matrix-transform = &default_transform;
    // };
    

&kscan0 {
    
    col-gpios = 
                <&gpio1 11 GPIO_ACTIVE_HIGH>,
                <&gpio1 6 GPIO_ACTIVE_HIGH>,
                <&gpio1 4 GPIO_ACTIVE_HIGH>,
                <&gpio0 11 GPIO_ACTIVE_HIGH>,
                <&gpio1 0 GPIO_ACTIVE_HIGH>,
                <&gpio0 24 GPIO_ACTIVE_HIGH>,
                <&gpio11 7 GPIO_ACTIVE_HIGH>;

    

};
&default_transform { // Offset of 3 because the left side has 3 columns
    col-offset = <7>;
};