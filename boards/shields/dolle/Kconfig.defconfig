## boards/shields/dolle/Kconfig.defconfig
```kconfig
if SHIELD_DOLLE_LEFT

config ZMK_POINTING
    default y
    
# Name must be less than 16 characters long!
config ZMK_KEYBOARD_NAME
    default "Dolle"

config ZMK_SPLIT_ROLE_CENTRAL
    default y

endif

if SHIELD_DOLLE_LEFT || SHIELD_DOLLE_RIGHT

config ZMK_SPLIT
    default y

endif
```

## boards/shields/dolle/Kconfig.shield
```kconfig
# No whitespace after the comma or in your part name!
config SHIELD_DOLLE_LEFT
    def_bool $(shields_list_contains,Dolle_left)

# No whitespace after the comma or in your part name!
config SHIELD_DOLLE_RIGHT
    def_bool $(shields_list_contains,Dolle_right)
```

## boards/shields/twintest/Kconfig.defconfig
```kconfig
if SHIELD_TWINTEST

# Name must be less than 16 characters long!
config ZMK_KEYBOARD_NAME
    default "TwinTest"

config CONFIG_BT
    default true
endif
```
